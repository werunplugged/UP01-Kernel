## kernel-4.19/drivers/misc/mediatek/fingerprint/focaltech_ree/Kconfig
```kconfig
config FINGERPRINT_FOCALTECH_REE
	tristate "FocalTech FingerPrint"
	default n
   	help
		If you say Y to this option, support will be included for
		the FocalTech's fingerprint sensor. This driver supports
		both REE and TEE.

		This driver can also be built as a module. If so, the module
		will be called 'focaltech_fp'.
```

## kernel-4.19/drivers/power/wireless/Kconfig
```kconfig
config WIRELESS_POWER_MT5728
	bool "mt5728 programable power supply class for wireless"
	depends on POWER_SUPPLY
	default n
	help
	  Say Y to enable
	  mt5728 programable power supply class for wireless
	  Say N to disable
	  mt5728 programable power supply class for wireless
```

## vendor/kernel-4.19/drivers/misc/mediatek/fingerprint/Kconfig
```kconfig
config CUST_FINGERPRINT_SUPPORT
  bool "CUST_FINGERPRINT_SUPPORT"
  default n

source "drivers/misc/mediatek/fingerprint/focaltech_ree/Kconfig"
source "drivers/misc/mediatek/fingerprint/focaltech_tee/Kconfig"
```

## vendor/kernel-4.19/drivers/misc/mediatek/fingerprint/focaltech_fp/Kconfig
```kconfig
#
# Focaltech Fingerprint driver configuration
#

config FINGERPRINT_FOCALTECH
    tristate "FocalTech Fingerprint"
    default m
    help
      If you say Y to this option, support will be included for 
      the FocalTech's capacitive or optical fingerprint sensor. 
      This driver supports almost all the TEE solutions just like 
      QSEE, Trustonic, TrustKernel, Beanpod.., also including 
      REE emulation.

      This driver can also be built as a module. If so, the module 
      will be called 'focaltech_fp'.
```

## vendor/kernel-4.19/drivers/misc/mediatek/up_devices/Kconfig
```kconfig
config CUST_DEVICE_INFO_SUPPORT
	bool "CUST_DEVICE_INFO_SUPPORT for MediaTek package"
	default n
	help
	It support different type sensor
	in this platform. If this option
	is set, it will support ambient
	and light sensor MTK_EPL2182_NEW.
```
